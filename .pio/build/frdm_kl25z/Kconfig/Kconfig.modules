## .pio/build/frdm_kl25z/Kconfig/Kconfig.modules
```kconfig
config ZEPHYR__BARE_MODULE_MODULE
	bool
	default y
menu "acpica (C:/Users/alber/.platformio/packages/framework-zephyr/_pio/modules/lib/acpica)"
osource "$(ZEPHYR_ACPICA_KCONFIG)"
config ZEPHYR_ACPICA_MODULE
	bool
	default y
endmenu
menu "cmsis (C:/Users/alber/.platformio/packages/framework-zephyr/_pio/modules/hal/cmsis)"
osource "$(ZEPHYR_CMSIS_KCONFIG)"
config ZEPHYR_CMSIS_MODULE
	bool
	default y
endmenu
menu "cmsis-dsp (C:/Users/alber/.platformio/packages/framework-zephyr/_pio/modules/lib/cmsis-dsp)"
osource "$(ZEPHYR_CMSIS_DSP_KCONFIG)"
config ZEPHYR_CMSIS_DSP_MODULE
	bool
	default y
endmenu
menu "cmsis-nn (C:/Users/alber/.platformio/packages/framework-zephyr/_pio/modules/lib/cmsis-nn)"
osource "$(ZEPHYR_CMSIS_NN_KCONFIG)"
config ZEPHYR_CMSIS_NN_MODULE
	bool
	default y
endmenu
menu "cmsis_6 (C:/Users/alber/.platformio/packages/framework-zephyr/_pio/modules/hal/cmsis_6)"
osource "$(ZEPHYR_CMSIS_6_KCONFIG)"
config ZEPHYR_CMSIS_6_MODULE
	bool
	default y
endmenu
menu "fatfs (C:/Users/alber/.platformio/packages/framework-zephyr/_pio/modules/fs/fatfs)"
osource "$(ZEPHYR_FATFS_KCONFIG)"
config ZEPHYR_FATFS_MODULE
	bool
	default y
endmenu
menu "hal_nxp (C:/Users/alber/.platformio/packages/framework-zephyr/_pio/modules/hal/nxp)"
osource "$(ZEPHYR_HAL_NXP_KCONFIG)"
config ZEPHYR_HAL_NXP_MODULE
	bool
	default y

config ZEPHYR_HAL_NXP_MODULE_BLOBS
	bool
endmenu
menu "hal_st (C:/Users/alber/.platformio/packages/framework-zephyr/_pio/modules/hal/st)"
osource "$(ZEPHYR_HAL_ST_KCONFIG)"
config ZEPHYR_HAL_ST_MODULE
	bool
	default y
endmenu
menu "hostap (C:/Users/alber/.platformio/packages/framework-zephyr/_pio/modules/lib/hostap)"
osource "$(ZEPHYR_HOSTAP_KCONFIG)"
config ZEPHYR_HOSTAP_MODULE
	bool
	default y
endmenu
menu "liblc3 (C:/Users/alber/.platformio/packages/framework-zephyr/_pio/modules/lib/liblc3)"
osource "$(ZEPHYR_LIBLC3_KCONFIG)"
config ZEPHYR_LIBLC3_MODULE
	bool
	default y
endmenu
config ZEPHYR_LIBMCTP_MODULE
	bool
	default y
config ZEPHYR_LIBMETAL_MODULE
	bool
	default y
menu "littlefs (C:/Users/alber/.platformio/packages/framework-zephyr/_pio/modules/fs/littlefs)"
osource "$(ZEPHYR_LITTLEFS_KCONFIG)"
config ZEPHYR_LITTLEFS_MODULE
	bool
	default y
endmenu
menu "loramac-node (C:/Users/alber/.platformio/packages/framework-zephyr/_pio/modules/lib/loramac-node)"
osource "$(ZEPHYR_LORAMAC_NODE_KCONFIG)"
config ZEPHYR_LORAMAC_NODE_MODULE
	bool
	default y
endmenu
menu "lvgl (C:/Users/alber/.platformio/packages/framework-zephyr/_pio/modules/lib/gui/lvgl)"
osource "C:/Users/alber/.platformio/packages/framework-zephyr/_pio/modules/lib/gui/lvgl/zephyr/Kconfig"
config ZEPHYR_LVGL_MODULE
	bool
	default y
endmenu
menu "mbedtls (C:/Users/alber/.platformio/packages/framework-zephyr/_pio/modules/crypto/mbedtls)"
osource "$(ZEPHYR_MBEDTLS_KCONFIG)"
config ZEPHYR_MBEDTLS_MODULE
	bool
	default y
endmenu
config ZEPHYR_MCUBOOT_MODULE
	bool
	default y
config ZEPHYR_MIPI_SYS_T_MODULE
	bool
	default y
menu "nrf_wifi (C:/Users/alber/.platformio/packages/framework-zephyr/_pio/modules/lib/nrf_wifi)"
osource "$(ZEPHYR_NRF_WIFI_KCONFIG)"
config ZEPHYR_NRF_WIFI_MODULE
	bool
	default y

config ZEPHYR_NRF_WIFI_MODULE_BLOBS
	bool
endmenu
config ZEPHYR_OPEN_AMP_MODULE
	bool
	default y
menu "openthread (C:/Users/alber/.platformio/packages/framework-zephyr/_pio/modules/lib/openthread)"
osource "$(ZEPHYR_OPENTHREAD_KCONFIG)"
config ZEPHYR_OPENTHREAD_MODULE
	bool
	default y
endmenu
menu "percepio (C:/Users/alber/.platformio/packages/framework-zephyr/_pio/modules/debug/percepio)"
osource "C:/Users/alber/.platformio/packages/framework-zephyr/_pio/modules/debug/percepio/zephyr/Kconfig"
config ZEPHYR_PERCEPIO_MODULE
	bool
	default y
endmenu
menu "picolibc (C:/Users/alber/.platformio/packages/framework-zephyr/_pio/modules/lib/picolibc)"
osource "C:/Users/alber/.platformio/packages/framework-zephyr/_pio/modules/lib/picolibc/zephyr/Kconfig"
config ZEPHYR_PICOLIBC_MODULE
	bool
	default y
endmenu
menu "segger (C:/Users/alber/.platformio/packages/framework-zephyr/_pio/modules/debug/segger)"
osource "$(ZEPHYR_SEGGER_KCONFIG)"
config ZEPHYR_SEGGER_MODULE
	bool
	default y
endmenu
config ZEPHYR_TINYCRYPT_MODULE
	bool
	default y
menu "uoscore-uedhoc (C:/Users/alber/.platformio/packages/framework-zephyr/_pio/modules/lib/uoscore-uedhoc)"
osource "$(ZEPHYR_UOSCORE_UEDHOC_KCONFIG)"
config ZEPHYR_UOSCORE_UEDHOC_MODULE
	bool
	default y
endmenu
menu "zcbor (C:/Users/alber/.platformio/packages/framework-zephyr/_pio/modules/lib/zcbor)"
osource "$(ZEPHYR_ZCBOR_KCONFIG)"
config ZEPHYR_ZCBOR_MODULE
	bool
	default y
endmenu
```

## .pio/build/frdm_kl25z/Kconfig/arch/Kconfig
```kconfig
# Load Zephyr Arch Kconfig descriptions.
osource "C:/Users/alber/.platformio/packages/framework-zephyr/arch/rx/Kconfig"
osource "C:/Users/alber/.platformio/packages/framework-zephyr/arch/x86/Kconfig"
osource "C:/Users/alber/.platformio/packages/framework-zephyr/arch/xtensa/Kconfig"
osource "C:/Users/alber/.platformio/packages/framework-zephyr/arch/sparc/Kconfig"
osource "C:/Users/alber/.platformio/packages/framework-zephyr/arch/riscv/Kconfig"
osource "C:/Users/alber/.platformio/packages/framework-zephyr/arch/posix/Kconfig"
osource "C:/Users/alber/.platformio/packages/framework-zephyr/arch/mips/Kconfig"
osource "C:/Users/alber/.platformio/packages/framework-zephyr/arch/arm64/Kconfig"
osource "C:/Users/alber/.platformio/packages/framework-zephyr/arch/arm/Kconfig"
osource "C:/Users/alber/.platformio/packages/framework-zephyr/arch/arc/Kconfig"
```

## .pio/build/frdm_kl25z/Kconfig/boards/Kconfig.defconfig
```kconfig
# Load Zephyr board defconfig descriptions.
osource "C:/Users/alber/.platformio/packages/framework-zephyr/boards/nxp/frdm_kl25z/Kconfig.defconfig"
```

## .pio/build/frdm_kl25z/Kconfig/boards/Kconfig.frdm_kl25z
```kconfig
# Load board Kconfig descriptions.
osource "C:/Users/alber/.platformio/packages/framework-zephyr/boards/nxp/frdm_kl25z/Kconfig.frdm_kl25z"
```
